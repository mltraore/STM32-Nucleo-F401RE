# file: UART_2_WAY_COM.ioc
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Mcu.Family=STM32F4
RCC.VCOOutputFreq_Value=336000000
RCC.APB2Freq_Value=84000000
RCC.CortexFreq_Value=84000000
Mcu.Name=STM32F401R(D-E)Tx
RCC.APB1CLKDivider=RCC_HCLK_DIV2
RCC.48MHZClocksFreq_Value=48000000
RCC.SYSCLKFreq_VALUE=84000000
Mcu.Package=LQFP64
RCC.SYSCLKSource=RCC_SYSCLKSOURCE_PLLCLK
ProjectManager.StackSize=0x400
ProjectManager.HeapSize=0x200
ProjectManager.TargetToolchain=SW4STM32
RCC.HSI_VALUE=16000000
RCC.PLLP=RCC_PLLP_DIV4
RCC.PLLQ=7
NVIC.PriorityGroup=NVIC_PRIORITYGROUP_0
RCC.HCLKFreq_Value=84000000
RCC.PLLN=336
RCC.APB2TimFreq_Value=84000000
RCC.APB1TimFreq_Value=84000000
RCC.APB1Freq_Value=42000000
RCC.AHBFreq_Value=84000000
PA5.Signal=GPIO_Output
RCC.HSE_VALUE=8000000
board=NUCLEO-F401RE

// file: Core/Src/main.c
/* USER CODE BEGIN Header */
/**
  ******************************************************************************
  * @file           : main.c
  * @brief          : Main program body
  ******************************************************************************
  * @attention
  *
  * <h2><center>&copy; Copyright (c) 2020 STMicroelectronics.
  * All rights reserved.</center></h2>
  *
  * This software component is licensed by ST under BSD 3-Clause license,
  * the "License"; You may not use this file except in compliance with the
  * License. You may obtain a copy of the License at:
  *                        opensource.org/licenses/BSD-3-Clause
  *
  ******************************************************************************
  */
/* USER CODE END Header */
#include "main.h"
#include <stdio.h>

void SystemClock_Config(void);
static void MX_GPIO_Init(void);

/* USER CODE BEGIN 0 */

// USART2 initialization

void USART2_Init(void)
{

   //Enable Clocks
   RCC->AHB1ENR |= RCC_AHB1ENR_GPIOAEN;     // Enable GPIOA   Clock
   RCC->APB1ENR |= RCC_APB1ENR_USART2EN;    // Enable USART2  Clock

   //Configure Pins [AF]
   GPIOA->MODER  |= 0x00A0;                 // Enable AF for PA2 and PA3
   GPIOA->AFR[0] |= 0x7700;//GPIO_AF7_USART2;        // Enable AF7 for USART2

   //Configure USART2
   USART2->BRR  = 0x1117;   // 9600bps   @42Mhz
   USART2->CR1  = USART_CR1_RE;
   USART2->CR1 |= USART_CR1_TE;    // Enable: TX, RX, USART
   USART2->CR1 |= USART_CR1_UE;
}

/* USER CODE END 0 */

//extern void initialise_monitor_handles(void);

int main(void)
{
  /* USER CODE BEGIN 1 */
	//initialise_monitor_handles();

  /* USER CODE END 1 */

  /* MCU Configuration--------------------------------------------------------*/

  /* Reset of all peripherals, Initializes the Flash interface and the Systick. */

  /* Configure the system clock */
  SystemClock_Config();

  /* Initialize all configured peripherals */
  MX_GPIO_Init();

  /* Infinite loop */
  /* USER CODE BEGIN WHILE */

	HAL_Init();

	int n;
	char str[100];
	USART2_Init();
	printf("Hello from the other side\r\n");
	fprintf(stdout," test for stdout\r\n");
	fprintf(stderr," test for stderr\r\n");

  while (1)
  {
    /* USER CODE END WHILE */
	  printf("How old are you?\r\n");
	  scanf("%d",&n);
	  printf("Your age is %d\r\n",n);
	  printf("Enter your first name: ");
	  gets(str);
	  printf("I like your style: ");
	  puts(str);
	  printf("\r\n");

  }
}

int USART2_Write(int ch)
{
   while(!(USART2->SR & USART_SR_TXE)) {}
   USART2->DR = (ch & 0xFF);
   return ch;
}

int USART2_Read(void)
{
   while(!(USART2->SR & USART_SR_RXNE)) {}
   return USART2->DR;
}

struct __FILE{int handle;};
FILE __stdin  = {0};
FILE __stdout = {1};
FILE __stderr = {2};

int fgetc(FILE *f)
{
  int c;
  c = USART2_Read();
  if(c == '\r')
  {
	  USART2_Write(c);
	  c='\n';
  }
  USART2_Write(c);
  return c;
}

int fputc(int c, FILE *f)
{
  return USART2_Write(c);
}

void SystemClock_Config(void)
{
  RCC_OscInitTypeDef RCC_OscInitStruct = {0};
  RCC_ClkInitTypeDef RCC_ClkInitStruct = {0};

  /** Configure the main internal regulator output voltage
  */
  __HAL_RCC_PWR_CLK_ENABLE();
  __HAL_PWR_VOLTAGESCALING_CONFIG(PWR_REGULATOR_VOLTAGE_SCALE2);
  /** Initializes the RCC Oscillators according to the specified parameters
  * in the RCC_OscInitTypeDef structure.
  */
  RCC_OscInitStruct.OscillatorType = RCC_OSCILLATORTYPE_HSI;
  RCC_OscInitStruct.HSIState = RCC_HSI_ON;
  RCC_OscInitStruct.HSICalibrationValue = RCC_HSICALIBRATION_DEFAULT;
  RCC_OscInitStruct.PLL.PLLState = RCC_PLL_ON;
  RCC_OscInitStruct.PLL.PLLSource = RCC_PLLSOURCE_HSI;
  RCC_OscInitStruct.PLL.PLLM = 16;
  RCC_OscInitStruct.PLL.PLLN = 336;
  RCC_OscInitStruct.PLL.PLLP = RCC_PLLP_DIV4;
  RCC_OscInitStruct.PLL.PLLQ = 7;
  if (HAL_RCC_OscConfig(&RCC_OscInitStruct) != HAL_OK)
  {
    Error_Handler();
  }
  /** Initializes the CPU, AHB and APB buses clocks
  */
  RCC_ClkInitStruct.ClockType = RCC_CLOCKTYPE_HCLK|RCC_CLOCKTYPE_SYSCLK
                              |RCC_CLOCKTYPE_PCLK1|RCC_CLOCKTYPE_PCLK2;
  RCC_ClkInitStruct.SYSCLKSource = RCC_SYSCLKSOURCE_PLLCLK;
  RCC_ClkInitStruct.AHBCLKDivider = RCC_SYSCLK_DIV1;
  RCC_ClkInitStruct.APB1CLKDivider = RCC_HCLK_DIV2;
  RCC_ClkInitStruct.APB2CLKDivider = RCC_HCLK_DIV1;

  if (HAL_RCC_ClockConfig(&RCC_ClkInitStruct, FLASH_LATENCY_2) != HAL_OK)
  {
    Error_Handler();
  }
}

static void MX_GPIO_Init(void)
{
  GPIO_InitTypeDef GPIO_InitStruct = {0};

  /* GPIO Ports Clock Enable */
  __HAL_RCC_GPIOA_CLK_ENABLE();

  /*Configure GPIO pin Output Level */
  HAL_GPIO_WritePin(GPIOA, GPIO_PIN_5, GPIO_PIN_RESET);

  /*Configure GPIO pin : PA5 */
  GPIO_InitStruct.Pin = GPIO_PIN_5;
  GPIO_InitStruct.Mode = GPIO_MODE_OUTPUT_PP;
  GPIO_InitStruct.Pull = GPIO_NOPULL;
  GPIO_InitStruct.Speed = GPIO_SPEED_FREQ_LOW;
  HAL_GPIO_Init(GPIOA, &GPIO_InitStruct);

}

void Error_Handler(void)
{
}

/************************ (C) COPYRIGHT STMicroelectronics *****END OF FILE****/
